## config/west.yml
```yaml
manifest:
  remotes:
    - name: theoneLYJ
      url-base: https://github.com/theoneLYJ
  projects:
    - name: zmk
      remote: klesh
      revision: main
      import: app/west.yml
  self:
    path: config
```
